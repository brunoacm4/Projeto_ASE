## access_monitor/main/Kconfig.projbuild
```kconfig
menu "Access Monitor Configuration"

    config PROJECT_ENABLE_MQTT
        bool "Enable MQTT publishing"
        default n

    config PROJECT_BROKER_URL
        string "MQTT broker URL"
        default "mqtt://CONFIGURE_ME:1883"
        depends on PROJECT_ENABLE_MQTT

    config PROJECT_PIR_ACTIVE_HIGH
        bool "PIR output is active-high"
        default y

endmenu
```
